## boards/arm/splinky/Kconfig.board
```kconfig
# Copyright (c) 2022 Pete Johanson
# Copyright (c) 2024, Nicolas Munnich
# SPDX-License-Identifier: Apache-2.0

config BOARD_SPLINKY
	bool "Splinky Board"
	depends on SOC_RP2040
	imply RETAINED_MEM
	imply RETENTION
	imply RETENTION_BOOT_MODE
```

## boards/bastardkb/splinky/board.yml
```yaml
# Copyright (c) 2022 Pete Johanson
# Copyright (c) 2024, Nicolas Munnich
# SPDX-License-Identifier: Apache-2.0

board:
  name: splinky
  vendor: bastardkb
  socs:
    - name: rp2040
```

## boards/bastardkb/splinky/splinky_defconfig
```kconfig
# SPDX-License-Identifier: Apache-2.0

CONFIG_SYS_CLOCK_HW_CYCLES_PER_SEC=125000000

# enable uart driver
CONFIG_SERIAL=n

# enable console
CONFIG_CONSOLE=n
CONFIG_UART_CONSOLE=n
CONFIG_UART_INTERRUPT_DRIVEN=y

# Enable reset by default
CONFIG_RESET=y

# Code partition needed to target the correct flash range
CONFIG_USE_DT_CODE_PARTITION=y

# Output UF2 by default, native bootloader supports it.
CONFIG_BUILD_OUTPUT_UF2=y

CONFIG_ZMK_USB=y
CONFIG_CLOCK_CONTROL=y

# RGB underglow via PIO (not SPI)
CONFIG_ZMK_RGB_UNDERGLOW=y
CONFIG_ZMK_RGB_UNDERGLOW_EXT_POWER=n
```

## boards/shields/charybdis/Kconfig.defconfig
```kconfig
if SHIELD_CHARYBDIS_RIGHT

config ZMK_KEYBOARD_NAME
    default "BastardKB Charybdis"

config ZMK_SPLIT_ROLE_CENTRAL
    default y

config SPI
    default y

config INPUT
    default y

config ZMK_POINTING
    default y

endif

if SHIELD_CHARYBDIS_LEFT || SHIELD_CHARYBDIS_RIGHT

config ZMK_SPLIT
    default y

endif
```

## boards/shields/charybdis_4x6/Kconfig.defconfig
```kconfig
if SHIELD_CHARYBDIS_4X6_RIGHT

config ZMK_KEYBOARD_NAME
    default "BastardKB Charybdis 4x6"

config ZMK_SPLIT_ROLE_CENTRAL
    default y

endif

if SHIELD_CHARYBDIS_4X6_LEFT || SHIELD_CHARYBDIS_4X6_RIGHT

config ZMK_SPLIT
    default y
config ZMK_SPLIT_SERIAL
    default y
config ZMK_SPLIT_SERIAL_UART
    default y
config ZMK_SPLIT_SERIAL_UART_POLL
    default n

endif
```

## boards/shields/charybdis_4x6/Kconfig.shield
```kconfig
config SHIELD_CHARYBDIS_4X6_LEFT
    def_bool $(shields_list_contains,charybdis_4x6_left)

config SHIELD_CHARYBDIS_4X6_RIGHT
    def_bool $(shields_list_contains,charybdis_4x6_right)
```

## boards/shields/charybdis_mini/Kconfig.defconfig
```kconfig
if SHIELD_CHARYBDIS_MINI_RIGHT

config ZMK_KEYBOARD_NAME
    default "BastardKB Charybdis Mini"

config ZMK_SPLIT_ROLE_CENTRAL
    default y

config SPI
    default y

config INPUT
    default y

config ZMK_POINTING
    default y

endif

if SHIELD_CHARYBDIS_MINI_LEFT || SHIELD_CHARYBDIS_MINI_RIGHT

config ZMK_SPLIT
    default y

endif
```

## boards/shields/charybdis_mini/Kconfig.shield
```kconfig
config SHIELD_CHARYBDIS_MINI_LEFT
    def_bool $(shields_list_contains,charybdis_mini_left)

config SHIELD_CHARYBDIS_MINI_RIGHT
    def_bool $(shields_list_contains,charybdis_mini_right)
```

## boards/shields/charybdis_nano/Kconfig.defconfig
```kconfig
if SHIELD_CHARYBDIS_NANO_RIGHT

config ZMK_KEYBOARD_NAME
    default "BastardKB Charybdis Nano"

config ZMK_SPLIT_ROLE_CENTRAL
    default y

config SPI
    default y

config INPUT
    default y

config ZMK_POINTING
    default y

endif

if SHIELD_CHARYBDIS_NANO_LEFT || SHIELD_CHARYBDIS_NANO_RIGHT

config ZMK_SPLIT
    default y

endif
```

## boards/shields/charybdis_nano/Kconfig.shield
```kconfig
config SHIELD_CHARYBDIS_LEFT
    def_bool $(shields_list_contains,charybdis_nano_left)

config SHIELD_CHARYBDIS_RIGHT
    def_bool $(shields_list_contains,charybdis_nano_right)
```

## boards/shields/dilemma/Kconfig.defconfig
```kconfig
if SHIELD_DILEMMA_RIGHT

config ZMK_KEYBOARD_NAME
    default "BastardKB Dilemma"

config ZMK_SPLIT_ROLE_CENTRAL
    default y

endif

if SHIELD_DILEMMA_LEFT || SHIELD_DILEMMA_RIGHT

config ZMK_SPLIT
    default y
config ZMK_SPLIT_SERIAL
    default y

endif
```

## boards/shields/elite_c_holder/Kconfig.defconfig
```kconfig
if SHIELD_ELITE_C_HOLDER

config ZMK_KEYBOARD_NAME
    default "BastardKB Elite-C-Holder"

endif
```

## boards/shields/elite_c_holder/Kconfig.shield
```kconfig
config SHIELD_ELITE_C_HOLDER
    def_bool $(shields_list_contains,elite_c_holder)
```

## boards/shields/scylla/Kconfig.defconfig
```kconfig
if SHIELD_SCYLLA_RIGHT

config ZMK_KEYBOARD_NAME
    default "BastardKB Scylla"

config ZMK_SPLIT_ROLE_CENTRAL
    default y

endif

if SHIELD_SCYLLA_LEFT || SHIELD_SCYLLA_RIGHT

config ZMK_SPLIT
    default y

endif
```

## boards/shields/splinktegrated/Kconfig.defconfig
```kconfig
if SHIELD_SPLINKTEGRATED

config ZMK_KEYBOARD_NAME
    default "BastardKB Splinktegrated"

endif
```

## boards/shields/splinktegrated/Kconfig.shield
```kconfig
config SHIELD_SPLINKTEGRATED
    def_bool $(shields_list_contains,splinktegrated)
```

## boards/shields/splinterface/Kconfig.defconfig
```kconfig
if SHIELD_SPLINTERFACE

config ZMK_KEYBOARD_NAME
    default "Splinterface"

endif
```

## boards/shields/tbkmini/Kconfig.defconfig
```kconfig
if SHIELD_TBKMINI_RIGHT

config ZMK_KEYBOARD_NAME
    default "BastardKB TBK Mini"

config ZMK_SPLIT_ROLE_CENTRAL
    default y

endif

if SHIELD_TBKMINI_LEFT || SHIELD_TBKMINI_RIGHT

config ZMK_SPLIT
    default y

endif
```

## config/west.yml
```yaml
manifest:
  remotes:
    - name: zmkfirmware
      url-base: https://github.com/zmkfirmware
    - name: xudongzheng
      url-base: https://github.com/xudongzheng
    - name: taz
      url-base: https://github.com/thazhemadam
    - name: bullwinkle3000
      url-base: https://github.com/bullwinkle3000

    # Additional modules containing boards/shields/custom code can be listed here as well
    # See https://docs.zephyrproject.org/3.2.0/develop/west/manifest.html#projects
  projects:
    - name: zmk
      remote: taz
      revision: xudongzheng/split-serial-pr
      import: app/west.yml
    - name: zmk-pmw3610-driver
      remote: taz
      revision: pmw3360

  self:
    path: config
```
