/*
 * Copyright (c) 2020 Pete Johanson
 * Copyright (c) 2024 burkfers
 *
 * SPDX-License-Identifier: MIT
 */

/ {
	splinktegrated_r: connector_r {
		compatible = "bastardkb,splinktegrated-rows";
		#gpio-cells = <2>;
		gpio-map-mask = <0xffffffff 0xffffffc0>;
		gpio-map-pass-thru = <0 0x3f>;
		gpio-map
			= <1 0 &elite_c 29 0>	
			, <2 0 &elite_c 26 0>	
			, <3 0 &elite_c  5 0>	
			, <4 0 &elite_c  4 0>	
			, <5 0 &elite_c  9 0>	
			, <6 0 &elite_c  5 0>	

			;
	};

	splinktegrated_c: connector_c {
		compatible = "bastardkb,splinktegrated-cols";
		#gpio-cells = <2>;
		gpio-map-mask = <0xffffffff 0xffffffc0>;
		gpio-map-pass-thru = <0 0x3f>;
		gpio-map
			= <1 0 &elite_c 27 0>
			, <2 0 &elite_c 28 0>
			, <3 0 &elite_c 21 0>
			, <4 0 &elite_c  6 0>
			, <5 0 &elite_c  7 0>
			, <6 0 &elite_c  8 0>
			;
	};
};
