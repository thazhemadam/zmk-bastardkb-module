#include "dilemma.dtsi"

&pio0_uart0 {
    pinctrl-0 = <&pio0_uart0_left>;
};

// TODO: try to update definitions to use direct GPIO?
// TODO: move into a common dtsi file
&kscan0 {
    // debounce-press-ms = <8>;
    // debounce-release-ms = <16>;
    row-gpios
        = <&pro_micro 18 GPIO_ACTIVE_HIGH> /* RP2040 GPIO 26 */
        , <&pro_micro  4 GPIO_ACTIVE_HIGH> /* RP2040 GPIO 4  */
        , <&pro_micro  5 GPIO_ACTIVE_HIGH> /* RP2040 GPIO 5  */
        , <&pro_micro 19 GPIO_ACTIVE_HIGH> /* RP2040 GPIO 27 */
        ;

    col-gpios
        = <&pro_micro  8 (GPIO_ACTIVE_HIGH | GPIO_PULL_DOWN)>  /* RP2040 GPIO 8  */
        , <&pro_micro  9 (GPIO_ACTIVE_HIGH | GPIO_PULL_DOWN)>  /* RP2040 GPIO 9  */
        , <&pro_micro  7 (GPIO_ACTIVE_HIGH | GPIO_PULL_DOWN)>  /* RP2040 GPIO 7  */
        , <&pro_micro  6 (GPIO_ACTIVE_HIGH | GPIO_PULL_DOWN)>  /* RP2040 GPIO 6  */
        , <&pro_micro 20 (GPIO_ACTIVE_HIGH | GPIO_PULL_DOWN)>  /* RP2040 GPIO 28 */
        ;
};
